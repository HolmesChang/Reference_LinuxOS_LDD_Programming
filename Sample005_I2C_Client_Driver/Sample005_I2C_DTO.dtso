/dts-v1/;
/plugin/;

/ {
	fragment@0 {
		target = < &i2c1 >;
		
		__overlay__ {
			clock-frequency = < 0x00061a80 >;
		};
	};
	
	fragment@1 {
		target = < &i2c1 >;
		
		__overlay__ {
			myi2c: myi2c@77 {
				reg = < 0x77 >;
				compatible = "my_i2c_driver";
			};
		};
	};
};
